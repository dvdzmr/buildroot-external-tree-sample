## external_tree/packages/python_local/Config.in
```kconfig
config BR2_PACKAGE_PYTHON_LOCAL
	bool "python_local"
	help
	  Replace python_local with the name of your package, and use this space to write a short description of your package.
```

## external_tree/packages/python_pypi/Config.in
```kconfig
config BR2_PACKAGE_PYTHON_PYPI
	bool "python_pyi"
	help
	  Replace python_pypi with the name of your package, and use this space to write a short description of your package.
```
